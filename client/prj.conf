## CMakeLists.txt
```
# /*============================================================================*
#  *         Copyright © 2019-2020 Signetik, LLC -- All Rights Reserved         *
#  *----------------------------------------------------------------------------*
#  *                                                              Signetik, LLC *
#  *                                                           www.signetik.com *
#  *                                      SPDX-License-Identifier: BSD-4-Clause *
#  *============================================================================*/

cmake_minimum_required(VERSION 3.13.1)

include($ENV{ZEPHYR_BASE}/cmake/app/boilerplate.cmake NO_POLICY_SCOPE)
project(client)


set(sources
	src/main.c
	src/uart_task.c
	src/vars.c
	src/wdt_task.c
	src/sigconfig.c
#	src/cbor.c
#	src/coap.c
#	src/cantcoap.c
#	src/sysdep.c
	src/LoRa_task.c
	src/led_task.c
	src/bt_task.c
	src/gatt_config_service.c
	src/modem_binary_interface_api.c
	src/modem_binary_interface_api_device.c
	src/modem_ascii_interface_api.c
)

# Main app
target_sources(app PRIVATE ${sources})
target_sources(app PRIVATE _sigver.c)
```

## Kconfig
```
# /*============================================================================*
#  *         Copyright © 2019-2021 Signetik, LLC -- All Rights Reserved         *
#  *----------------------------------------------------------------------------*
#  *                                                              Signetik, LLC *
#  *                                                           www.signetik.com *
#  *                                          SPDX-License-Identifier: Sigentik *
#  *                                                                            *
#  * Customer may modify, compile, assemble and convert this source code into   *
#  * binary object or executable code for use on Signetk products purchased     *
#  * from Signetik or its distributors.                                         *
#  *                                                                            *
#  * Customer may incorporate or embed an binary executable version of the      *
#  * software into the Customer’s product(s), which incorporate a Signetik      *
#  * product purchased from Signetik or its distributors. Customer may          *
#  * manufacture, brand and distribute such Customer’s product(s) worldwide to  *
#  * its End-Users.                                                             *
#  *                                                                            *
#  * This agreement must be formalized with Signetik before Customer enters     *
#  * production and/or distributes products to Customer's End-Users             *
#  *============================================================================*/

menu "Signetik Client"

choice SENSOR_POLLING_METHOD_UART_FORMAT
	bool "Sensor polling method UART format"
	default SENSOR_POLLING_METHOD_UART_PUSH
config SENSOR_POLLING_METHOD_UART_BINARY
	bool "Sensor UART binary modem"
config SENSOR_POLLING_METHOD_UART_PUSH
	bool "Sensor UART push sensor"
endchoice

choice  SIGNETIK_APP
	bool "Custom application"
	default SIGNETIK_APP_NONE
config SIGNETIK_APP_NONE
	bool "No custom application"
config SIGNETIK_APP_LORATEST
	bool "LoRa test application"
endchoice

module = SIGNETIK_CLIENT
module-dep = LOG
module-str = Signetik Client
source "${ZEPHYR_BASE}/subsys/logging/Kconfig.template.log_config"
endmenu

menu "Zephyr Kernel"
source "$ZEPHYR_BASE/Kconfig.zephyr"
endmenu
```

## prj.conf
```kconfig
# /*============================================================================*
#  *         Copyright © 2019-2021 Signetik, LLC -- All Rights Reserved         *
#  *----------------------------------------------------------------------------*
#  *                                                              Signetik, LLC *
#  *                                                           www.signetik.com *
#  *                                          SPDX-License-Identifier: Sigentik *
#  *                                                                            *
#  * Customer may modify, compile, assemble and convert this source code into   *
#  * binary object or executable code for use on Signetk products purchased     *
#  * from Signetik or its distributors.                                         *
#  *                                                                            *
#  * Customer may incorporate or embed an binary executable version of the      *
#  * software into the Customer’s product(s), which incorporate a Signetik      *
#  * product purchased from Signetik or its distributors. Customer may          *
#  * manufacture, brand and distribute such Customer’s product(s) worldwide to  *
#  * its End-Users.                                                             *
#  *                                                                            *
#  * This agreement must be formalized with Signetik before Customer enters     *
#  * production and/or distributes products to Customer's End-Users             *
#  *============================================================================*/

CONFIG_SYSTEM_WORKQUEUE_STACK_SIZE=2048

CONFIG_BASE64=y
CONFIG_BT=y
CONFIG_BT_DEBUG_LOG=y
CONFIG_BT_SMP=y
CONFIG_BT_SIGNING=y
CONFIG_BT_PERIPHERAL=y
CONFIG_BT_DEVICE_NAME="SigLR"
CONFIG_BT_DEVICE_APPEARANCE=833
CONFIG_BT_DEVICE_NAME_DYNAMIC=y
CONFIG_BT_DEVICE_NAME_MAX=65
CONFIG_BT_SMP=y
CONFIG_BT_GATT_CLIENT=y
CONFIG_BT_GATT_DM=y
CONFIG_BT_GATT_DM_DATA_PRINT=y
CONFIG_BT_HCI=y
CONFIG_BT_CTLR=y
CONFIG_BT_LL_SW_SPLIT=y

CONFIG_BT_KEYS_OVERWRITE_OLDEST=y
CONFIG_BT_SETTINGS=y
CONFIG_FLASH=y
CONFIG_FLASH_PAGE_LAYOUT=y
CONFIG_FLASH_MAP=y
CONFIG_NVS=y
CONFIG_SETTINGS=y

CONFIG_SPI=y
CONFIG_ARM_MPU=y
CONFIG_LORA=y
CONFIG_LORA_SX12XX=y
CONFIG_LORAWAN=y
CONFIG_LORAMAC_REGION_US915=y
CONFIG_CONSOLE=y
CONFIG_UART_CONSOLE=y
CONFIG_SERIAL=y
#CONFIG_SPI_0=y
CONFIG_GPIO=y
CONFIG_NFCT_PINS_AS_GPIOS=y
CONFIG_CLOCK_CONTROL_NRF_K32SRC_RC=y
CONFIG_CLOCK_CONTROL_NRF_K32SRC_250PPM=y

CONFIG_SENSOR_POLLING_METHOD_UART_BINARY=y
CONFIG_SENSOR_POLLING_METHOD_UART_PUSH=y
CONFIG_WATCHDOG=y

# RTT Debug (Yes, activate J-Link console via Segger RTT)
CONFIG_USE_SEGGER_RTT=y
CONFIG_RTT_CONSOLE=y
CONFIG_UART_RTT=y

CONFIG_SIGNETIK_MODEM_API=y
```

## src/main.c
```c
/*============================================================================*
 *         Copyright © 2019-2021 Signetik, LLC -- All Rights Reserved         *
 *----------------------------------------------------------------------------*
 *                                                              Signetik, LLC *
 *                                                           www.signetik.com *
 *                                          SPDX-License-Identifier: Sigentik *
 *                                                                            *
 * Customer may modify, compile, assemble and convert this source code into   *
 * binary object or executable code for use on Signetk products purchased     *
 * from Signetik or its distributors.                                         *
 *                                                                            *
 * Customer may incorporate or embed an binary executable version of the      *
 * software into the Customer’s product(s), which incorporate a Signetik      *
 * product purchased from Signetik or its distributors. Customer may          *
 * manufacture, brand and distribute such Customer’s product(s) worldwide to  *
 * its End-Users.                                                             *
 *                                                                            *
 * This agreement must be formalized with Signetik before Customer enters     *
 * production and/or distributes products to Customer's End-Users             *
 *============================================================================*/

#include <stdio.h>
#include <string.h>
#include <zephyr.h>
#include <device.h>
#include <drivers/gpio.h>
#include "led_task.h"
#include "bt_task.h"
#include "lora_task.h"
#include "uart_task.h"
#include "wdt_task.h"
#include "vars.h"
#include "sigversion.h"

#if	!defined(CONFIG_SIGNETIK_APP_NONE)
void custom_app_start(void);
#endif

void main(void)
{
	
	vars_init();

	// Get Firmware	Version	string.
	strncpy(var_firmware.data, GIT_TAG,	var_firmware.size);
		
	// Start RTOS task threads.
	wdt_thread_start();	// @todo Should	this start before other	threads??
	uart_thread_start();
	led_thread_start();
	bt_thread_start();
	lora_thread_start();
#if	!defined(CONFIG_SIGNETIK_APP_NONE)
	custom_app_start();
#endif

	while(1)
	{
		k_sleep(K_MSEC(1000));
	}
}
```

## src/LoRa_task.c
```c
/*============================================================================*
 *         Copyright © 2019-2021 Signetik, LLC -- All Rights Reserved         *
 *----------------------------------------------------------------------------*
 *                                                              Signetik, LLC *
 *                                                           www.signetik.com *
 *                                          SPDX-License-Identifier: Sigentik *
 *                                                                            *
 * Customer may modify, compile, assemble and convert this source code into   *
 * binary object or executable code for use on Signetk products purchased     *
 * from Signetik or its distributors.                                         *
 *                                                                            *
 * Customer may incorporate or embed an binary executable version of the      *
 * software into the Customer’s product(s), which incorporate a Signetik      *
 * product purchased from Signetik or its distributors. Customer may          *
 * manufacture, brand and distribute such Customer’s product(s) worldwide to  *
 * its End-Users.                                                             *
 *                                                                            *
 * This agreement must be formalized with Signetik before Customer enters     *
 * production and/or distributes products to Customer's End-Users             *
 *============================================================================*/

/*
 * Module Includes.
 */

#include <stdio.h>
#include <string.h>
#include <lorawan/lorawan.h>
#include <device.h>
#include <zephyr.h>

#include <drivers/gpio.h>
#include <drivers/lora.h>
#include <lorawan/lorawan.h>

#include <sys/base64.h>

#include <logging/log.h>

#include "signetik.h"
#include "wdt_task.h"
#include "lora_task.h"
#include "uart_task.h"
#include "led_task.h"
#include "vars.h"

/*
 * Extract devicetree configuration.
 */

#define	DEFAULT_RADIO_NODE DT_ALIAS(lora0)
BUILD_ASSERT(DT_NODE_HAS_STATUS(DEFAULT_RADIO_NODE,	okay),
		 "No default LoRa radio	specified in DT");
#define	DEFAULT_RADIO DT_LABEL(DEFAULT_RADIO_NODE)


LOG_MODULE_REGISTER(loratask,	CONFIG_SIGNETIK_CLIENT_LOG_LEVEL);

K_SEM_DEFINE(sem_rx_cb,	0, 1);
K_SEM_DEFINE(sem_lora_push,	0, 1);
K_SEM_DEFINE(sem_tx_busy, 0, 1);

K_MSGQ_DEFINE(lora_tx_queue, sizeof(struct lora_tx_message), 4,	4);	/* 4 messages, 4 byte alignment	*/

/*
 * Module Defines
 */
#define	LORA_TX_BUF_SIZE 255

#define	MAX_TX_DATA_LEN	12
#define	MAX_RX_DATA_LEN	255
//#define	TX_CW

void custom_app_rx(uint8_t *buffer, int sz);

/*
 * Module Variables.
 */

struct lora_modem_config config	= 
{
	.frequency = 902300000,
	.bandwidth = BW_125_KHZ,
	.datarate	= SF_10,
	.preamble_len	= 8,
	.coding_rate = CR_4_5,
	.tx_power	= -9, //4;	-9dBm for testing w/o antenna
	.tx	=	true
};

char txData[MAX_TX_DATA_LEN] = {0x64, 0x01,	0x00, 0x00,	0x00, 0x0E,	0xE1, 0x39,	0x00, 0x00,	0x00, 0x00};
uint8_t	rxData[MAX_RX_DATA_LEN]	= {0};

/*
 * Local Functions
 */
static int lora_configure(struct lorawan_join_config *join_cfg)
{
	int	ret	= 0;

	// determine Class operation
	if (strcmp(strupr(var_lora_class.data),	"A") ==	0)
	{
		lorawan_set_class(LORAWAN_CLASS_A);
	}
	else if	(strcmp(strupr(var_lora_class.data), "C") == 0)
	{
		lorawan_set_class(LORAWAN_CLASS_C);
	}
	else
	{
		ret	= -1;
	}

	// Adaptive	data rate selection
	lorawan_enable_adr(var_lora_adr);

	// Data	rate selection	(Function ignores datarate if ADR is set.)
	lorawan_set_datarate(var_lora_datarate);

	// Channel mask	selection
	lorawan_set_channelmask((uint16_t*)&var_lora_chan_mask.data[0]);

	// RX delay setting
	lorawan_set_rxdelay(var_lora_rxdelay1, var_lora_rxdelay2);

	lorawan_set_datarate(var_lora_datarate);

	if (strcmp(strupr(var_lora_auth.data),	"ABP")	== 0)
	{
	//	Authentication by personalization
		join_cfg->mode = LORAWAN_ACT_ABP;
		join_cfg->dev_eui =	var_lora_dev_eui.data;			// var_lora_dev_eui.data;
		join_cfg->abp.dev_addr = *((uint32_t*)var_lora_dev_addr.data);			// device address
		join_cfg->abp.app_skey = var_lora_app_skey.data;		// var_lora_app_skey.data;
		join_cfg->abp.nwk_skey = var_lora_nwk_skey.data;		// var_lora_nwk_skey.data;
		join_cfg->abp.app_eui =	var_lora_dev_eui.data;			// var_lora_app_eui.data;
	}
	else if	(strcmp(strupr(var_lora_auth.data),	"OTAA")	== 0)
	{
	//	Over The Air Authentication
		join_cfg->mode = LORAWAN_ACT_OTAA;
		join_cfg->dev_eui =	var_lora_dev_eui.data;
		join_cfg->otaa.join_eui	= var_lora_app_eui.data;
		join_cfg->otaa.app_key = var_lora_app_key.data;
	}
	else
	{
	// Invalid option, clear the configuration structure
		memset(&join_cfg, 0x0, sizeof(join_cfg));
		ret	= -1;
	}
	return ret;
}

void display_base64_data(uint8_t *buffer, int sz);

void lorawan_tx_data(bool success, uint32_t	channel, uint8_t data_rate, uint8_t tx_power)
{
	char status_str[32];

	static led_msg_t led_msg = {
		.red = true,
		.green = false,
		.blue =	true,
		.enable	= false
	};

	k_msgq_put(&led_msgq, &led_msg,	K_MSEC(100));
	k_sem_give(&sem_tx_busy);

	snprintf(status_str, sizeof(status_str)-1, "chan:%d,dr:%d,pow:%d",	channel, data_rate, tx_power);

	k_sem_take(&sem_rx_cb, K_FOREVER);
	if (success) {
		uart_send("+notify,lora:tx,status:success,", 0);
		LOG_INF("+notify,lora:tx,status:success,");
	}
	else {
		uart_send("+notify,lora:tx,status:fail,", 0);
		LOG_INF("+notify,lora:tx,status:fail,");
	}
	uart_send(status_str, 0);
	uart_send("\r\n", 0);
	LOG_INF("%s", log_strdup(status_str));
	k_sem_give(&sem_rx_cb);
}

void lorawan_rx_data(uint8_t *buffer, int sz, uint8_t port, int16_t rssi, uint8_t data_rate)
{
	char status_str[32];

	led_msg_t led_msg = {
		.red = false,
		.green = true,
		.blue =	false,
		.enable	= true
	};

	k_msgq_put(&led_msgq, &led_msg,	K_MSEC(100));

	if (sz > 0)	{
#if	!defined(CONFIG_SIGNETIK_APP_NONE)
		custom_app_rx(buffer, sz);
#endif
		snprintf(status_str, sizeof(status_str)-1, ",port:%d,dr:%d,rssi:%d",	port, data_rate, rssi);

		k_sem_take(&sem_rx_cb, K_FOREVER);
		uart_send("+notify,lora:rx,base64:", 0);
		LOG_INF("+notify,lora:rx,base64:");
		display_base64_data(buffer, sz);
		uart_send(status_str, 0);
		uart_send("\r\n", 0);
		LOG_INF("%s", log_strdup(status_str));
		k_sem_give(&sem_rx_cb);
	}

	led_msg.enable = false;
	k_msgq_put(&led_msgq, &led_msg,	K_MSEC(100));
}

void display_base64_data(uint8_t *buffer, int sz)
{
	uint8_t	obuffer[64];
	size_t obuffer_len = 64;

	base64_encode(obuffer, obuffer_len,	&obuffer_len, buffer, sz);
	uart_send(obuffer, obuffer_len);
	obuffer[obuffer_len] = 0;
	LOG_INF("%s", log_strdup(obuffer));
}

#define	FORCE_GPIO_1_7_HIGH	1

static struct lora_tx_message msg;

/*
 * Public Functions
 */
void lora_thread(void *p1, void	*p2, void *p3)
{
	uint8_t	thread_id;
	int16_t	rssi;
	int8_t snr;
	int	len;
	struct lorawan_join_config lw_config;	/* loraWan configuration */
	int	ret;
	int	err;
	int	record_number =	0;
	char txData[MAX_TX_DATA_LEN] = {0x64, 0x01,	0x00, 0x00,	0x00, 0x0E,	0xE1, 0x39,	0x00, 0x00,	0x00, 0x00};
	uint8_t	rxData[MAX_RX_DATA_LEN]	= {0};

	const struct device	*lora_dev;
	const struct device	*dev1;

	lora_dev = device_get_binding(DEFAULT_RADIO);
	if (!lora_dev) 
	{
		LOG_ERR("%s	Device not found", DEFAULT_RADIO);
		return;
	}

	// Register	with WDT.
	thread_id =	wdt_register_thread();

	k_sem_give(&sem_rx_cb);
	k_sem_give(&sem_lora_push);

	// Register	with WDT.
//	thread_id =	wdt_register_thread();

#if	defined(FORCE_GPIO_1_7_HIGH)
	dev1 = device_get_binding("GPIO_1");
	gpio_pin_configure(dev1, 7,	GPIO_OUTPUT_ACTIVE);
	gpio_pin_set(dev1, 7,	1);
#endif
#if	(1)

	while (1)
	{
		LOG_DBG("LoRa Thread loop...");

		// Feed	WDT	(must use assigned thread ID).
		wdt_feed_watchdog(thread_id);

		if (!var_connected && var_enabled) 
		{
			if (0 == lorawan_start())
			{
				uart_send("+notify,lora:join,status:start\r\n",	0);
			}

			lorawan_set_txcb(lorawan_tx_data);
			lorawan_set_rxcb(lorawan_rx_data);
			
			ret	= lora_configure(&lw_config);
			if (0 != ret)
			{
				LOG_ERR("Invalid LoRa configuration.");
				printk("(ret %d)\n", ret);
				uart_send("+notify,lora:join,status:rejected\r\n", 0);
			}
			else
			{
				uart_send("+notify,lora:join,status:send\r\n", 0);
				switch (lorawan_join(&lw_config))
				{
				case 0:
					uart_send("+notify,lora:join,status:complete\r\n", 0);
					var_connected =	true;
					break;

				case -ETIMEDOUT:
					uart_send("+notify,lora:join,status:timeout\r\n", 0);
					break;

				case -ENOTCONN:
				case -ECONNREFUSED:
				default:
					uart_send("+notify,lora:join,status:rejected\r\n", 0);
					break;
				}
			}
			k_sleep(K_MSEC(1000));
		}
		else if	(var_enabled)
		{		/* Block until data	arrives	or 5 seconds	passes */
			k_sleep(K_MSEC(1000));
			if (k_msgq_get(&lora_tx_queue, &msg, K_NO_WAIT)	== 0) {
				led_msg_t led_msg = {
					.red = true,
					.green = false,
					.blue =	true,
					.enable	= true
				};

				k_sem_take(&sem_tx_busy, K_SECONDS(10));
				k_msgq_put(&led_msgq, &led_msg,	K_MSEC(100));

				LOG_INF("Send Lora Packet");
				uart_send("+notify,lora:tx,status:send,base64:", 0);
				display_base64_data(msg.message, msg.length);
				uart_send("\r\n", 0);
				ret = lorawan_send(1, msg.message, msg.length, 0 /*LORAWAN_MSG_CONFIRMED*/);
				if (ret != 0) {
					char status_str[16];

					snprintf(status_str, sizeof(status_str)-1, "err:%d", ret);

					uart_send("+notify,lora:tx,status:fail,", 0);
					uart_send(status_str, 0);
					uart_send("\r\n", 0);

					led_msg.blue = false;
					k_msgq_put(&led_msgq, &led_msg, K_MSEC(100));
					k_sleep(K_MSEC(1000));
					led_msg.enable = false;
					k_msgq_put(&led_msgq, &led_msg, K_MSEC(100));
				}
			}
#if(0)			
			len	= lora_recv(lora_dev, rxData,	MAX_RX_DATA_LEN, K_MSEC(5000), &rssi, &snr);

			if (len	< 0)
			{
				LOG_ERR("LoRa receive failed");
			}

			if (len	> 0) 
			{
				LOG_INF("Received data:	%s (RSSI:%ddBm,	SNR:%ddBm)",
				log_strdup(rxData),	rssi,	snr);
				uart_send("+notify,lora:rx,base64:\r\n", 0);
			}
#endif
		}
		else
		{
			// prohibit	sending	if lora	access now disabled
			var_connected =	false;
			k_sleep(K_MSEC(1000));
		}
	}
#elif(1)
	static uint16_t	channels[5];
	channels[0]	= channels[1] =	channels[2]	= channels[3] =	0;
	channels[0]	= 0x0f00;
	channels[4]	= 0xff;

	lorawan_start();
	lorawan_set_class(LORAWAN_CLASS_C);
	lorawan_enable_adr(false);
	lorawan_set_datarate(LORAWAN_DR_1);
	lorawan_set_channelmask(channels);

	const struct lorawan_join_config lw_config2	= {
		.abp = {
			0x26022001,	/* devid */
			app_skey,
			nwk_skey,
			app_eui
		},
		.dev_eui = dev_eui,
		.mode =	LORAWAN_ACT_ABP
	};
	lorawan_join(&lw_config2);
	while (1) {
		lorawan_send(1,	txData,	MAX_TX_DATA_LEN, 0 /*LORAWAN_MSG_CONFIRMED*/);
		k_sleep(K_MSEC(5000));
	}
#elif	defined(TX_CW)
	ret	= lora_config(lora_dev,	&config);
	if (ret	< 0) {
		LOG_ERR("LoRa config failed");
		return;
	}
	// Start continuous	wave transmission function expires after 65535 seconds
	lora_test_cw(lora_dev, config.frequency, config.tx_power,	65535);

	while(1) {
		LOG_INF("Continuous	Wave Tx	active.");
		k_sleep(K_MSEC(1000));
	}

#elif 0
	char txData[MAX_TX_DATA_LEN] = {'h', 'e', 'l', 'l',	'o', 'w', 'o', 'r',	'l', 'd'};
	uint8_t	rxData[MAX_RX_DATA_LEN]	= {0};
	while (1) {
		ret	= lora_config(lora_dev,	&config);
		ret	= lora_send(lora_dev, txData,	MAX_TX_DATA_LEN);
		if (ret	< 0) {
			LOG_ERR("LoRa send failed");
		}
		else {
			LOG_INF("Data sent!");
		}

		/* Block until data	arrives	or 5 seconds	passes */
		int16_t	rssi;
		int8_t snr;
		int	len	= lora_recv(lora_dev, rxData,	MAX_RX_DATA_LEN, K_MSEC(5000),
				&rssi, &snr);

		if (len	< 0) {
			LOG_ERR("LoRa receive failed");
		}

		if (len	> 0) {
			LOG_INF("Received data:	%s (RSSI:%ddBm,	SNR:%ddBm)",
			log_strdup(rxData),	rssi,	snr);

		}
	}
#endif
}

int	lora_push(char *key, char *value)
{
	int	ret	= -1;
	struct lora_tx_message msg;
	size_t msglen =	sizeof(msg.message);
	const struct device	*lora_dev;

	lora_dev = device_get_binding(DEFAULT_RADIO);
	if (!lora_dev) 
	{
		LOG_ERR("%s	Device not found", DEFAULT_RADIO);
		return ret;
	}
	else
	{
		ret	= base64_decode(msg.message, msglen, &msglen, &value[1], strlen(value)-2);
		if ((ret ==	0) && (msglen <= sizeof(msg.message)) && (msglen >	0))
		{	
			k_sem_take(&sem_lora_push, K_FOREVER);
			msg.length = msglen;

			ret	= k_msgq_put(&lora_tx_queue, &msg, K_NO_WAIT);
			if (0 != ret)
			{
				LOG_ERR("Lora Tx queue full\n");
			}
			k_sem_give(&sem_lora_push);
		}
	}
	return ret;
}

///	Create LoRa	thread/task.
K_THREAD_STACK_DEFINE(lora_stack_area, LORA_STACKSIZE);
struct k_thread	lora_thread_data;

///	Start LoRa thread.
void lora_thread_start(void)
{
	/* k_tid_t my_tid =	*/
	k_thread_create(&lora_thread_data, lora_stack_area,
		K_THREAD_STACK_SIZEOF(lora_stack_area),
		lora_thread,
		NULL, NULL,	NULL,
		LORA_PRIORITY, 0, K_NO_WAIT);
}
```

## src/LoRa_task.h
```c
/*============================================================================*
 *         Copyright © 2019-2021 Signetik, LLC -- All Rights Reserved         *
 *----------------------------------------------------------------------------*
 *                                                              Signetik, LLC *
 *                                                           www.signetik.com *
 *                                          SPDX-License-Identifier: Sigentik *
 *                                                                            *
 * Customer may modify, compile, assemble and convert this source code into   *
 * binary object or executable code for use on Signetk products purchased     *
 * from Signetik or its distributors.                                         *
 *                                                                            *
 * Customer may incorporate or embed an binary executable version of the      *
 * software into the Customer’s product(s), which incorporate a Signetik      *
 * product purchased from Signetik or its distributors. Customer may          *
 * manufacture, brand and distribute such Customer’s product(s) worldwide to  *
 * its End-Users.                                                             *
 *                                                                            *
 * This agreement must be formalized with Signetik before Customer enters     *
 * production and/or distributes products to Customer's End-Users             *
 *============================================================================*/

#ifndef	__LORA_TASK_H
#define	__LORA_TASK_H

#include "vars.h"

void lora_thread_start(void);
int	lora_push(char *key, char *value);

extern struct k_msgq lora_tx_queue;

#define	LORA_QUEUE_OBJECT_SIZE 53

struct lora_tx_message {
	uint32_t length;
	uint8_t	message[LORA_QUEUE_OBJECT_SIZE];
};


#endif /* __LORA_TASK_H	*/
```

## src/bt_task.c
```c
/*============================================================================*
 *         Copyright © 2019-2021 Signetik, LLC -- All Rights Reserved         *
 *----------------------------------------------------------------------------*
 *                                                              Signetik, LLC *
 *                                                           www.signetik.com *
 *                                          SPDX-License-Identifier: Sigentik *
 *                                                                            *
 * Customer may modify, compile, assemble and convert this source code into   *
 * binary object or executable code for use on Signetk products purchased     *
 * from Signetik or its distributors.                                         *
 *                                                                            *
 * Customer may incorporate or embed an binary executable version of the      *
 * software into the Customer’s product(s), which incorporate a Signetik      *
 * product purchased from Signetik or its distributors. Customer may          *
 * manufacture, brand and distribute such Customer’s product(s) worldwide to  *
 * its End-Users.                                                             *
 *                                                                            *
 * This agreement must be formalized with Signetik before Customer enters     *
 * production and/or distributes products to Customer's End-Users             *
 *============================================================================*/

/*
 * Module Includes.
 */
#include <zephyr/types.h>
#include <stddef.h>
#include <string.h>
#include <stdio.h>
#include <errno.h>
#include <sys/printk.h>
#include <sys/byteorder.h>
#include <zephyr.h>

#include <settings/settings.h>

#include <bluetooth/bluetooth.h>
#include <bluetooth/hci.h>
#include <bluetooth/conn.h>
#include <bluetooth/uuid.h>
#include <bluetooth/gatt.h>

#include <logging/log.h>

#include "signetik.h"
#include "wdt_task.h"
#include "bt_task.h"
#include "vars.h"

/*
 * Extract devicetree configuration.
 */


LOG_MODULE_REGISTER(bt_task,	CONFIG_SIGNETIK_CLIENT_LOG_LEVEL);

/*
 * Module Defines
 */



/*
 * Module Variables.
 */
static const struct	bt_data	ad[] = {
	BT_DATA_BYTES(BT_DATA_FLAGS, (BT_LE_AD_GENERAL | BT_LE_AD_NO_BREDR)),
	BT_DATA_BYTES(BT_DATA_UUID128_ALL,
	BT_UUID_128_ENCODE(0x1ff71400, 0xaddc, 0x49da, 0x8bb2, 0xa7026e65426d))
};

static void	connected(struct bt_conn *conn,	uint8_t	err)
{
	if (err) {
		printk("Connection failed (err 0x%02x)\n", err);
	} else {
		printk("Connected\n");
	}
}

static void	disconnected(struct	bt_conn	*conn, uint8_t reason)
{
	printk("Disconnected (reason 0x%02x)\n", reason);
}

static struct bt_conn_cb conn_callbacks	= {
	.connected = connected,
	.disconnected =	disconnected,
};

static void	bt_ready(void)
{
	int	err;

	printk("Bluetooth initialized\n");

	if (IS_ENABLED(CONFIG_SETTINGS)) {
		settings_load();
	}

	err	= bt_le_adv_start(BT_LE_ADV_CONN_NAME, ad, ARRAY_SIZE(ad), NULL, 0);
	if (err) {
		printk("Advertising	failed to start	(err %d)\n", err);
		return;
	}

	printk("Advertising	successfully started\n");
}

static void	auth_passkey_display(struct	bt_conn	*conn, unsigned	int	passkey)
{
	char addr[BT_ADDR_LE_STR_LEN];

	bt_addr_le_to_str(bt_conn_get_dst(conn), addr, sizeof(addr));

	printk("Passkey	for	%s:	%06u\n", addr, passkey);
}

static void	auth_cancel(struct bt_conn *conn)
{
	char addr[BT_ADDR_LE_STR_LEN];

	bt_addr_le_to_str(bt_conn_get_dst(conn), addr, sizeof(addr));

	printk("Pairing	cancelled: %s\n", addr);
}

static struct bt_conn_auth_cb auth_cb_display =	{
	.passkey_display = auth_passkey_display,
	.passkey_entry = NULL,
	.cancel	= auth_cancel,
};


/*
 * Public Functions
 */
void bt_thread(void	*p1, void	*p2, void *p3)
{
	int	err;
	uint8_t	thread_id;
	uint8_t	buf[CONFIG_BT_DEVICE_NAME_MAX];

	err	= bt_enable(NULL);
	if (err) {
		printk("Bluetooth init failed (err %d)\n", err);
		return;
	}

	// create advertised device	name from device name and ID

	snprintf(buf, sizeof(buf), "%s-%s",	CONFIG_BT_DEVICE_NAME, var_devid.data );
	bt_set_name(buf);

	bt_ready();

	bt_conn_cb_register(&conn_callbacks);
	bt_conn_auth_cb_register(&auth_cb_display);

	// Register	with WDT.
	thread_id =	wdt_register_thread();

	/* Implement notification. At the moment there is no suitable way
	 * of starting delayed work	so we do it	here
	 */
	while (1) 
	{
		// Feed	WDT	(must use assigned thread ID).
		wdt_feed_watchdog(thread_id);
		k_sleep(K_MSEC(1000));

	}
}

///	CreateBluetooth	thread/task.
K_THREAD_STACK_DEFINE(bt_stack_area, BT_STACKSIZE);
struct k_thread	bt_thread_data;

///	Start Bluetooth	thread.
void bt_thread_start(void)
{
	/* k_tid_t my_tid =	*/
	k_thread_create(&bt_thread_data, bt_stack_area,
		K_THREAD_STACK_SIZEOF(bt_stack_area),
		bt_thread,
		NULL, NULL,	NULL,
		BT_PRIORITY, 0,	K_NO_WAIT);
}
```

## src/bt_task.h
```c
/*============================================================================*
 *         Copyright © 2019-2021 Signetik, LLC -- All Rights Reserved         *
 *----------------------------------------------------------------------------*
 *                                                              Signetik, LLC *
 *                                                           www.signetik.com *
 *                                          SPDX-License-Identifier: Sigentik *
 *                                                                            *
 * Customer may modify, compile, assemble and convert this source code into   *
 * binary object or executable code for use on Signetk products purchased     *
 * from Signetik or its distributors.                                         *
 *                                                                            *
 * Customer may incorporate or embed an binary executable version of the      *
 * software into the Customer’s product(s), which incorporate a Signetik      *
 * product purchased from Signetik or its distributors. Customer may          *
 * manufacture, brand and distribute such Customer’s product(s) worldwide to  *
 * its End-Users.                                                             *
 *                                                                            *
 * This agreement must be formalized with Signetik before Customer enters     *
 * production and/or distributes products to Customer's End-Users             *
 *============================================================================*/

#ifndef	__BT_TASK_H
#define	__BT_TASK_H


void bt_thread_start(void);


#endif /* __BT_TASK_H */
```

## src/cantcoap.h
```c
#pragma once
//#pragma clang diagnostic ignored "-Wdeprecated-writable-strings"
//#pragma clang diagnostic ignored "-Wconstant-logical-operand"
//#pragma clang diagnostic ignored "-Wtautological-constant-out-of-range-compare"

/// Copyright (c) 2013, Ashley Mills.

// Adapted to C by Bruce Carlson, Signetik LLC.
// Copyright 2016 Signetik, LLC.
// All rights reserved.
// Signetik Confidential Proprietary Information -- Disclosure prohibited.
// www.signetik.com

//#include <unistd.h>
#include <stdint.h>
#include "dbg.h"

#define COAP_HDR_SIZE 4
#define COAP_OPTION_HDR_BYTE 1

// CoAP PDU format

//  0                   1                   2                   3
//  0 1 2 3 4 5 6 7 8 9 0 1 2 3 4 5 6 7 8 9 0 1 2 3 4 5 6 7 8 9 0 1
// +-+-+-+-+-+-+-+-+-+-+-+-+-+-+-+-+-+-+-+-+-+-+-+-+-+-+-+-+-+-+-+-+
// |Ver| T |  TKL  |      Code     |          Message ID           |
// +-+-+-+-+-+-+-+-+-+-+-+-+-+-+-+-+-+-+-+-+-+-+-+-+-+-+-+-+-+-+-+-+
// |   Token (if any, TKL bytes) ...
// +-+-+-+-+-+-+-+-+-+-+-+-+-+-+-+-+-+-+-+-+-+-+-+-+-+-+-+-+-+-+-+-+
// |   Options (if any) ...
// +-+-+-+-+-+-+-+-+-+-+-+-+-+-+-+-+-+-+-+-+-+-+-+-+-+-+-+-+-+-+-+-+
// |1 1 1 1 1 1 1 1|    Payload (if any) ...
// +-+-+-+-+-+-+-+-+-+-+-+-+-+-+-+-+-+-+-+-+-+-+-+-+-+-+-+-+-+-+-+-+



/// CoAP message types. Note, values only work as enum.
typedef enum {
	COAP_CONFIRMABLE=0x00,
	COAP_NON_CONFIRMABLE=0x10,
	COAP_ACKNOWLEDGEMENT=0x20,
	COAP_RESET=0x30
} CoapPDU_Type;

// CoAP response codes.
typedef enum {
	COAP_EMPTY=0x00,
	COAP_GET,
	COAP_POST,
	COAP_PUT,
	COAP_DELETE,
	COAP_CREATED=0x41,
	COAP_DELETED,
	COAP_VALID,
	COAP_CHANGED,
	COAP_CONTENT,
	COAP_BAD_REQUEST=0x80,
	COAP_UNAUTHORIZED,
	COAP_BAD_OPTION,
	COAP_FORBIDDEN,
	COAP_NOT_FOUND,
	COAP_METHOD_NOT_ALLOWED,
	COAP_NOT_ACCEPTABLE,
	COAP_PRECONDITION_FAILED=0x8C,
	COAP_REQUEST_ENTITY_TOO_LARGE=0x8D,
	COAP_UNSUPPORTED_CONTENT_FORMAT=0x8F,
	COAP_INTERNAL_SERVER_ERROR=0xA0,
	COAP_NOT_IMPLEMENTED,
	COAP_BAD_GATEWAY,
	COAP_SERVICE_UNAVAILABLE,
	COAP_GATEWAY_TIMEOUT,
	COAP_PROXYING_NOT_SUPPORTED,
	COAP_UNDEFINED_CODE=0xFF
} CoapPDU_Code;

/// CoAP option numbers.
typedef enum {
	COAP_OPTION_IF_MATCH=1,
	COAP_OPTION_URI_HOST=3,
	COAP_OPTION_ETAG,
	COAP_OPTION_IF_NONE_MATCH,
	COAP_OPTION_OBSERVE,
	COAP_OPTION_URI_PORT,
	COAP_OPTION_LOCATION_PATH,
	COAP_OPTION_URI_PATH=11,
	COAP_OPTION_CONTENT_FORMAT,
	COAP_OPTION_MAX_AGE=14,
	COAP_OPTION_URI_QUERY,
	COAP_OPTION_ACCEPT=17,
	COAP_OPTION_LOCATION_QUERY=20,
	COAP_OPTION_BLOCK2=23,
	COAP_OPTION_BLOCK1=27,
	COAP_OPTION_SIZE2,
	COAP_OPTION_PROXY_URI=35,
	COAP_OPTION_PROXY_SCHEME=39,
	COAP_OPTION_SIZE1=60
} CoapPDU_Option;

/// CoAP content-formats.
typedef enum {
	COAP_CONTENT_FORMAT_TEXT_PLAIN = 0,
	COAP_CONTENT_FORMAT_APP_LINK  = 40,
	COAP_CONTENT_FORMAT_APP_XML,
	COAP_CONTENT_FORMAT_APP_OCTET,
	COAP_CONTENT_FORMAT_APP_EXI   = 47,
	COAP_CONTENT_FORMAT_APP_JSON  = 50,
	COAP_CONTENT_FORMAT_APP_CBOR  = 60,	// per http://www.iana.org/assignments/core-parameters/core-parameters.xhtml
	//61-95 are Unassigned by iana. so free for custom use
	COAP_CONTENT_FORMAT_CBOR_LORA = 61
} CoapPDU_ContentFormat;


/// Sequence of these is returned by CoapPDU::getOptions()
typedef struct {
	uint16_t optionDelta;
	uint16_t optionNumber;
	uint16_t optionValueLength;
	int totalLength;
	uint8_t *optionPointer;
	uint8_t *optionValuePointer;
} CoapPDU_CoapOption;


struct CoapPDU {

// 	// construction and destruction
// 	CoapPDU();
// 	CoapPDU(uint8_t *pdu, int pduLength);
// 	CoapPDU(uint8_t *buffer, int bufferLength, int pduLength);
// 	~CoapPDU();
// 	int reset();
// 	int validate();

// 	// version
// 	int setVersion(uint8_t version);
// 	uint8_t getVersion();

// 	// message type
// 	void setType(CoapPDU::Type type);
// 	CoapPDU::Type getType();

// 	// tokens
// 	int setTokenLength(uint8_t tokenLength);
// 	int getTokenLength();
// 	uint8_t* getTokenPointer();
// 	int setToken(uint8_t *token, uint8_t tokenLength);

// 	// message code
// 	void setCode(CoapPDU::Code code);
// 	CoapPDU::Code getCode();
// 	CoapPDU::Code httpStatusToCode(int httpStatus);

// 	// message ID
// 	int setMessageID(uint16_t messageID);
// 	uint16_t getMessageID();

// 	// options
// 	int addOption(uint16_t optionNumber, uint16_t optionLength, uint8_t *optionValue);
// 	// gets a list of all options
// 	CoapOption* getOptions();
// 	int getNumOptions();
// 	// shorthand helpers
// 	int setURI(char *uri);
// 	int setURI(char *uri, int urilen);
// 	int getURI(char *dst, int dstlen, int *outLen);
// 	int addURIQuery(char *query);

// 	// content format helper
// 	int setContentFormat(CoapPDU::ContentFormat format);
// 	// payload
// 	uint8_t* mallocPayload(int bytes);
// 	int setPayload(uint8_t *value, int len);
// 	uint8_t* getPayloadPointer();
// 	int getPayloadLength();
// 	uint8_t* getPayloadCopy();

// 	// pdu
// 	int getPDULength();
// 	uint8_t* getPDUPointer();
// 	void setPDULength(int len);

// 	// debugging
// 	static void printBinary(uint8_t b);
// 	void print();
// 	void printBin();
// 	void printHex();
// 	void printOptionHuman(uint8_t *option);
// 	void printHuman();
// 	void printPDUAsCArray();

// private:
	// variables
	uint8_t *_pdu;
	int _pduLength;

	int _constructedFromBuffer;
	int _bufferLength;

	uint8_t *_payloadPointer;
	int _payloadLength;

	int _numOptions;
	uint16_t _maxAddedOptionNumber;

	// // functions
	// void shiftPDUUp(int shiftOffset, int shiftAmount);
	// void shiftPDUDown(int startLocation, int shiftOffset, int shiftAmount);
	// uint8_t codeToValue(CoapPDU::Code c);

	// // option stuff
	// int findInsertionPosition(uint16_t optionNumber, uint16_t *prevOptionNumber);
	// int computeExtraBytes(uint16_t n);
	// int insertOption(int insertionPosition, uint16_t optionDelta, uint16_t optionValueLength, uint8_t *optionValue);
	// uint16_t getOptionDelta(uint8_t *option);
	// void setOptionDelta(int optionPosition, uint16_t optionDelta);
	// uint16_t getOptionValueLength(uint8_t *option);

};

/*
#define COAP_CODE_EMPTY 0x00

// method codes 0.01-0.31
#define COAP_CODE_GET 	0x01
#define COAP_CODE_POST 	0x02
#define COAP_CODE_PUT 	0x03
#define COAP_CODE_DELETE 0x04

// Response codes 2.00 - 5.31
// 2.00 - 2.05
#define COAP_CODE_CREATED 0x41
#define COAP_CODE_DELETED 0x42
#define COAP_CODE_VALID   0x43
#define COAP_CODE_CHANGED 0x44
#define COAP_CODE_CONTENT 0x45

// 4.00 - 4.15
#define COAP_CODE_BAD_REQUEST                0x80
#define COAP_CODE_UNAUTHORIZED               0x81
#define COAP_CODE_BAD_OPTION                 0x82
#define COAP_CODE_FORBIDDEN                  0x83
#define COAP_CODE_NOT_FOUND                  0x84
#define COAP_CODE_METHOD_NOT_ALLOWED         0x85
#define COAP_CODE_NOT_ACCEPTABLE             0x86
#define COAP_CODE_PRECONDITION_FAILED        0x8C
#define COAP_CODE_REQUEST_ENTITY_TOO_LARGE   0x8D
#define COAP_CODE_UNSUPPORTED_CONTENT_FORMAT 0x8F

// 5.00 - 5.05
#define COAP_CODE_INTERNAL_SERVER_ERROR      0xA0
#define COAP_CODE_NOT_IMPLEMENTED            0xA1
#define COAP_CODE_BAD_GATEWAY                0xA2
#define COAP_CODE_SERVICE_UNAVAILABLE        0xA3
#define COAP_CODE_GATEWAY_TIMEOUT            0xA4
#define COAP_CODE_PROXYING_NOT_SUPPORTED     0xA5
*/



void CoapPDU_Init(struct CoapPDU *x, uint8_t *buffer, int bufferLength, int pduLength);
int CoapPDU_reset(struct CoapPDU *x);
int CoapPDU_validate(struct CoapPDU *x);
void CoapPDU_Destroy(struct CoapPDU *x);
uint8_t* CoapPDU_getPDUPointer(struct CoapPDU *x);
void CoapPDU_setPDULength(struct CoapPDU *x, int len);
//int CoapPDU_setURI(struct CoapPDU *x, char *uri);
int CoapPDU_setURI(struct CoapPDU *x, char *uri);
int CoapPDU_addURIQuery(struct CoapPDU *x, char *query);
int CoapPDU_getURI(struct CoapPDU *x, char *dst, int dstlen, int *outLen);
int CoapPDU_setVersion(struct CoapPDU *x, uint8_t version);
uint8_t CoapPDU_getVersion(struct CoapPDU *x);
void CoapPDU_setType(struct CoapPDU *x, CoapPDU_Type mt);
CoapPDU_Type CoapPDU_getType(struct CoapPDU *x);
int CoapPDU_setTokenLength(struct CoapPDU *x, uint8_t tokenLength);
int CoapPDU_getTokenLength(struct CoapPDU *x);
uint8_t* CoapPDU_getTokenPointer(struct CoapPDU *x);
int CoapPDU_setToken(struct CoapPDU *x, uint8_t *token, uint8_t tokenLength);
void CoapPDU_setCode(struct CoapPDU *x, CoapPDU_Code code);
CoapPDU_Code CoapPDU_getCode(struct CoapPDU *x);
CoapPDU_Code CoapPDU_httpStatusToCode(struct CoapPDU *x, int httpStatus);
int CoapPDU_setMessageID(struct CoapPDU *x, uint16_t messageID);
uint16_t CoapPDU_getMessageID(struct CoapPDU *x);
int CoapPDU_getPDULength(struct CoapPDU *x);
int CoapPDU_getNumOptions(struct CoapPDU *x);
CoapPDU_CoapOption* CoapPDU_getOptions(struct CoapPDU *x);
int CoapPDU_addOption(struct CoapPDU *x, uint16_t insertedOptionNumber, uint16_t optionValueLength, uint8_t *optionValue);
int CoapPDU_addPath(struct CoapPDU *x, const char *path);
uint8_t* CoapPDU_mallocPayload(struct CoapPDU *x, int len);
int CoapPDU_setPayload(struct CoapPDU *x, const uint8_t *payload, int len);
uint8_t* CoapPDU_getPayloadPointer(struct CoapPDU *x);
int CoapPDU_getPayloadLength(struct CoapPDU *x);
uint8_t* CoapPDU_getPayloadCopy(struct CoapPDU *x);
int CoapPDU_setContentFormat(struct CoapPDU *x, CoapPDU_ContentFormat format);

/// PRIVATE PRIVATE PRIVATE PRIVATE PRIVATE PRIVATE PRIVATE

void CoapPDU_shiftPDUUp(struct CoapPDU *x, int shiftOffset, int shiftAmount);
void CoapPDU_shiftPDUDown(struct CoapPDU *x, int startLocation, int shiftOffset, int shiftAmount);
uint16_t CoapPDU_getOptionValueLength(struct CoapPDU *x, uint8_t *option);
uint16_t CoapPDU_getOptionDelta(struct CoapPDU *x, uint8_t *option);
int CoapPDU_findInsertionPosition(struct CoapPDU *x, uint16_t optionNumber, uint16_t *prevOptionNumber);
int computeExtraBytes(uint16_t n);
void CoapPDU_setOptionDelta(struct CoapPDU *x, int optionPosition, uint16_t optionDelta);
int CoapPDU_insertOption(struct CoapPDU *x, int insertionPosition, uint16_t optionDelta, uint16_t optionValueLength, uint8_t *optionValue);

// DEBUG DEBUG DEBUG DEBUG DEBUG DEBUG DEBUG DEBUG DEBUG DEBUG DEBUG

void CoapPDU_printHuman(struct CoapPDU *x);
void CoapPDU_printPDUAsCArray(struct CoapPDU *x);
void CoapPDU_printOptionHuman(struct CoapPDU *x, uint8_t *option);
void CoapPDU_printHex(struct CoapPDU *x);
void CoapPDU_printBin(struct CoapPDU *x);
void CoapPDU_printBinary(uint8_t b);
void CoapPDU_print(struct CoapPDU *x);
```

## src/cbor.h
```c
// Copyright 2016 Signetik, LLC.
// All rights reserved.
// Signetik Confidential Proprietary Information -- Disclosure prohibited.
// Author: Bruce Carlson
// www.signetik.com


#ifndef CBOR_H
#define CBOR_H

#include <stdint.h>
#include <stdbool.h>

#ifdef __cplusplus
extern "C" {
#endif

// Compiler/Machine-specific:
#if defined(CBOR_FLOAT_SUPPORT)
#include <arm_math.h>	// defines float32_t and float64_t
#ifndef float32_t			// todo : how to verify float is really 32 bits?
#define float32_t float
#endif
#ifndef float64_t			// todo : how to verify double is really 64 bits?
#define float64_t double
#endif
#endif


// Some functions in this module return cbor_data_t, which is a struct.
//#pragma GCC diagnostic ignored "-Waggregate-return"
// It would be nice if you could disable this warning on a per-function basis.

// CBOR tag types per RFC 7049 Table 3
typedef enum {
	CBOR_STANDARD_DATE_TIME_STRING	=     0,
	CBOR_EPOCH_DATE_TIME			=     1,
	CBOR_POS_BIGNUM					=     2,
	CBOR_NEG_BIGNUM					=     3,
	CBOR_DECIMAL_FRACTION			=     4,
	CBOR_BIGFLOAT					=     5,

	CBOR_CONVERT_TO_BASE64URL		=    21,
	CBOR_CONVERT_TO_BASE64			=    22,
	CBOR_CONVERT_TO_BASE16			=    23,
	CBOR_ENCODED_CBOR				=    24,

	CBOR_URI						=    32,
	CBOR_BASE64URL					=    33,
	CBOR_BASE64						=    34,
	CBOR_REGEX						=    35,
	CBOR_MIME						=    36,

	CBOR_SELF_DESCRIBE_CBOR			= 55799,

	CBOR_TAG_INVALID				=	 -1
} cbor_tag_t;


/** CBOR data handle or "cursor" that moves sequentially through the
	 buffer as data is written or read.
	A cbor_data_t is good for only one pass through the buffer (reading or writing).
	To go back to the beginning of the buffer the cursor must be re-initialized
	 by once again providing it with the buffer start and length.
 */
typedef struct {
	uint8_t *b;		// pointer to the next location to read/write
	int len;		// how much data remains to be read OR how much space is available to be written
} cbor_data_t;

cbor_data_t cbor_cursor(uint8_t *data, int len);
bool cbor_empty(cbor_data_t d);
cbor_data_t cbor_get_read_cursor(cbor_data_t current_cbor_cursor, uint8_t *original_buffer_pointer);


// WRITING CBOR

// cbor_put_ functions write to the cbor buffer and move the cursor ahead.

void cbor_put_int(						cbor_data_t *d, int64_t x);
void cbor_put_raw(						cbor_data_t *d, uint8_t *data, unsigned int data_len);
void cbor_put_raw_start_indefinite(		cbor_data_t *d);
void cbor_put_text(						cbor_data_t *d, const char *text);
void cbor_put_text_start_indefinite(	cbor_data_t *d);
void cbor_put_array_start(				cbor_data_t *d, unsigned int array_element_count);
void cbor_put_array_start_indefinite(	cbor_data_t *d);
void cbor_put_map_start(				cbor_data_t *d, unsigned int map_element_count);
void cbor_put_map_start_indefinite(		cbor_data_t *d);
void cbor_put_end_indefinite(			cbor_data_t *d);
void cbor_put_tag(						cbor_data_t *d, cbor_tag_t tag);
#if defined(CBOR_FLOAT_SUPPORT)
void cbor_put_single(					cbor_data_t *d, float32_t x);
void cbor_put_single_reverse(			cbor_data_t *d, float32_t x);

void cbor_put_double(					cbor_data_t *d, float64_t x);
#endif
void cbor_put_null(						cbor_data_t *d);
void cbor_put_undefined(				cbor_data_t *d);
void cbor_put_bool(						cbor_data_t *d, bool x);

// READING CBOR

// cbor_is_ functions return information about the next cbor item in the buffer without moving the cursor.

bool cbor_is_int(		cbor_data_t d);
bool cbor_is_raw(		cbor_data_t d);
bool cbor_is_text(		cbor_data_t d);
bool cbor_is_array(		cbor_data_t d);
bool cbor_is_map(		cbor_data_t d);
bool cbor_is_half(		cbor_data_t d);
bool cbor_is_single(	cbor_data_t d);
bool cbor_is_double(	cbor_data_t d);
bool cbor_is_floating(	cbor_data_t d);
bool cbor_is_null(		cbor_data_t d);
bool cbor_is_undefined(	cbor_data_t d);
bool cbor_is_true(		cbor_data_t d);
bool cbor_is_false(		cbor_data_t d);
bool cbor_is_break(		cbor_data_t d);
bool cbor_is_bool(		cbor_data_t d);
#define cbor_is_end_indefinite(b) cbor_is_break(b)
bool cbor_is_indefinite_length(cbor_data_t d);
bool cbor_is_number(	cbor_data_t d);

bool cbor_has_tag(		cbor_data_t d);


// cbor_get_ functions read data from the cbor buffer and move the cursor ahead.

int64_t cbor_get_int(		cbor_data_t *d, int64_t default_val);
int		cbor_get_raw(		cbor_data_t *d, uint8_t *dest, int dest_len);
int 	cbor_get_raw_ptr(	cbor_data_t *source, uint8_t **ptr);
int		cbor_get_text(		cbor_data_t *d, char *dest, int dest_len);
int		cbor_get_array_count(cbor_data_t *d);
//void	cbor_enter_array(	cbor_data_t *d);
int		cbor_get_map_count(	cbor_data_t *d);
//void	cbor_enter_map(		cbor_data_t *d);

cbor_data_t cbor_map_contents(cbor_data_t d);

cbor_tag_t	cbor_get_tag(			cbor_data_t *d);
#if defined(CBOR_FLOAT_SUPPORT)
float32_t	cbor_get_half(			cbor_data_t *d);
float32_t	cbor_get_single(		cbor_data_t *d);
float64_t	cbor_get_double(		cbor_data_t *d);
float64_t	cbor_get_floating(		cbor_data_t *d);
#endif
int			cbor_get_bool(			cbor_data_t *d);
int64_t		cbor_get_number(		cbor_data_t *d, int64_t default_val);
#if defined(CBOR_FLOAT_SUPPORT)
float64_t	cbor_get_number_float(	cbor_data_t *d, float64_t default_val);
#endif

bool	cbor_skip(			cbor_data_t *d);
int		cbor_item_len(		cbor_data_t d);



// cbor_retrieve returns a named value from JSONish cbor

// suggest starting with cbor_retrieve_number
int64_t		cbor_retrieve_number(		cbor_data_t d, const char *item_path, int64_t default_val);
#if defined(CBOR_FLOAT_SUPPORT)
float64_t	cbor_retrieve_number_float(	cbor_data_t d, const char *item_path, float64_t default_val);
#endif

int64_t		cbor_retrieve_int(		cbor_data_t d, const char *item_path, int64_t default_val);
int			cbor_retrieve_raw(		cbor_data_t d, const char *item_path, uint8_t *dest, int dest_len);
int			cbor_retrieve_raw_ptr(	cbor_data_t d, const char *item_path, uint8_t **ptr);
int			cbor_retrieve_text(		cbor_data_t d, const char *item_path, char *dest, int dest_len, const char *default_val);
#if defined(CBOR_FLOAT_SUPPORT)
float64_t	cbor_retrieve_floating(	cbor_data_t d, const char *item_path);
#endif
int			cbor_retrieve_bool(		cbor_data_t d, const char *item_path);

// cbor_retrieve returns a new cursor that points to the requested data item
cbor_data_t cbor_retrieve(cbor_data_t d, const char *item_path);


void cbor_test(void);



#ifdef __cplusplus
}
#endif

#endif
```

## src/coap.c
```c
#include "coap.h"
#include "cantcoap.h"

//forward declarations
// static uint64_t generate_random_token(void);
// static uint16_t generate_message_id(void);

/** @brief Wrap payload into CoAP.
	@param buf - pointer to payload.
	@param len - Length of payload.
	@param coap_buf - pointer of pointer to caller allocated buffer to hold resulting CoAP
	@param coap_len - pointer to variable that holds length of coap_buf on input, and size of CoAP PDU on output
	@return none.
*/
void createCoapPDU(CoapPDU_ContentFormat format, const uint8_t *buf, size_t len, uint8_t **coap_buf, size_t *coap_len)
{
	struct CoapPDU pdu;
	//uint8_t *pcoap_buf = *coap_buf;

	CoapPDU_Init(&pdu, *coap_buf, *coap_len, 0);
	CoapPDU_setVersion(&pdu, 1);
	CoapPDU_setType(&pdu, COAP_NON_CONFIRMABLE);
	CoapPDU_setCode(&pdu, COAP_POST);
	CoapPDU_setToken(&pdu, (uint8_t*)"\3\2\1\1", 4);
	CoapPDU_setMessageID(&pdu, 0x0005);
	CoapPDU_setURI(&pdu, (char*)"/");
	CoapPDU_setContentFormat(&pdu, format);
	CoapPDU_setPayload(&pdu, buf, len);

	*coap_len = CoapPDU_getPDULength(&pdu);
}

/** @brief Extract payload from CoAP.
	@param buf - pointer to CoAP data.
	@param len - Length of CoAP data.
	@param payload - pointer of pointer to caller allocated buffer to hold extracted payload
	@param payload_len - length of payload
	@return none.
*/
void extractPayloadFromCoapPDU(uint8_t *buf, size_t len, uint8_t **payload, size_t *payload_len)
{
	struct CoapPDU pdu;
	uint8_t *ppayload = *payload;
	int status;

	CoapPDU_Init(&pdu, buf, len, len);
	CoapPDU_setContentFormat(&pdu, COAP_CONTENT_FORMAT_TEXT_PLAIN);
	CoapPDU_setPDULength(&pdu, len);
	status = CoapPDU_validate(&pdu);
	if(status == 0){
		*payload_len = 0;
		return;
	}
	memcpy(ppayload, CoapPDU_getPayloadPointer(&pdu), CoapPDU_getPayloadLength(&pdu));
	*payload_len = CoapPDU_getPayloadLength(&pdu);
}

#if 0
// Helpers
static uint64_t generate_random_token(void)
{
	static uint64_t x = 0;
	// todo: generate cryptographically random number
	// maybe we could use a timer as a cycle counter and do a hash of the timer value along with the clock and some ADC readings?
	// maybe also include the chip unique identifier in the hash?
	// The mbed TLS libary has a random number generator we might use.
	// See https://tools.ietf.org/html/rfc7252#section-5.3.1
	return x++;		// not so random yet.
}

static uint16_t generate_message_id(void)
{
	static uint16_t next_message_id = 0;
	// static uint16_t last_message_id;

	// todo: when we receive a message, set next_message_id = received_message_id + 1;
	// don't use the same message id twice in a row
	// do {
	// get new message ID
	// } while (new message ID == last_message_id);
	// last_message_id = new_message_id
	return next_message_id++;
}
#endif
```

## src/coap.h
```c
#ifndef COAP_H
#define COAP_H

#include <stdint.h>
#include <stdlib.h>

#ifdef __cplusplus
extern "C" {
#endif

#include "cantcoap.h"
void createCoapPDU(CoapPDU_ContentFormat format, const uint8_t *buf, size_t len, uint8_t **coap_buf, size_t *coap_len);
void extractPayloadFromCoapPDU(uint8_t *buf, size_t len, uint8_t **payload, size_t *payload_len);

#ifdef __cplusplus
}
#endif

#endif // COAP_H
```
